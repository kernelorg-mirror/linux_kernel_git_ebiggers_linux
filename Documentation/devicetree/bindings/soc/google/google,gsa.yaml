## Documentation/devicetree/bindings/soc/google/google,gsa.yaml
```yaml
# SPDX-License-Identifier: GPL-2.0-only OR BSD-2-Clause
%YAML 1.2
---
$id: http://devicetree.org/schemas/soc/google/google,gsa.yaml#
$schema: http://devicetree.org/meta-schemas/core.yaml#

title: Google Security Anchor (GSA)

maintainers:
  - Eric Biggers <ebiggers@kernel.org>

properties:
  compatible:
    enum:
      - google,gs101-gsa

  reg:
    maxItems: 1

  interrupts:
    maxItems: 1

required:
  - compatible
  - reg
  - interrupts

additionalProperties: false

examples:
  - |
    #include <dt-bindings/interrupt-controller/arm-gic.h>

    gsa: gsa@17c90000 {
        compatible = "google,gs101-gsa";
        reg = <0x17c90000 0x1000>;
        interrupts = <GIC_SPI 447 IRQ_TYPE_LEVEL_HIGH>;
    };
```

## drivers/soc/google/Kconfig
```kconfig
# SPDX-License-Identifier: GPL-2.0-only

if ARCH_EXYNOS || COMPILE_TEST

menu "Google SoC drivers"

config GOOGLE_SECURITY_ANCHOR
	tristate "Driver for Google Security Anchor (GSA)"
	help
	  This is the driver for the Google Security Anchor (GSA), also known as
	  the Google Tensor security core.  GSA consists of a dedicated CPU,
	  ROM, one-time programmable (OTP) memory, crypto engine, internal SRAM,
	  and protected DRAM.  Its use cases include protecting user data keys
	  at runtime, hardening secure boot, and interfacing with the Titan M2.

	  Enabling this driver allows the Universal Flash Storage (UFS) driver
	  to use GSA to support hardware-wrapped inline encryption keys on
	  Google Tensor SoCs.  Other functionality of GSA is not yet supported
	  by this driver.

endmenu

endif
```
